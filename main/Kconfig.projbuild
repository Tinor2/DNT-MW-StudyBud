## main/Kconfig.projbuild
```kconfig
menu "StudyBud Configuration"

    config EXAMPLE_AVOID_TEAR_EFFECT_WITH_SEM
        bool "Avoid tearing effect with semaphores"
        default y
        help
            Use a pair of semaphores to synchronize VSYNC with LVGL rendering,
            avoiding tearing on the RGB parallel LCD.

    config EXAMPLE_USE_BOUNCE_BUFFER
        bool "Use bounce buffer"
        default y
        help
            Enable bounce buffer mode for higher PCLK frequency at the cost
            of higher CPU consumption.

    config STUDYBUD_TIMEZONE
        string "Time zone (POSIX TZ string)"
        default "UTC0"
        help
            POSIX timezone string used for localtime() after SNTP sync,
            e.g. "UTC0" or "AEST-10AEDT,M10.1.0,M4.1.0/3".

endmenu
```
